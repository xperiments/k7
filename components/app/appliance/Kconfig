## components/app/appliance/Kconfig
```kconfig
menu "K7 appliance"

config K7_TRUST_DEV_ORIGIN
    bool "Trust the development App origin as well"
    default n
    help
      A development firmware build accepts the App served at
      https://k7-dev.xperiments.dev:8000 besides the deployed one at
      https://k7.xperiments.dev: its CORS reply and its MCP origin guard
      name whichever of the two made the request.

      Turn this on only for a board you develop against. A release is built
      from the sunton variant, which leaves it off, so a shipped binary
      carries the deployed origin alone (docs/adr/0082).

endmenu
```

## components/app/screen_display/Kconfig
```kconfig
menu "Screen display"

config APP_UI_SERIAL_DUMP
    bool "Dump the rendered screen over the serial console once at startup"
    depends on !APP_BOARD_SUNTON_8048S050C
    default n
    help
        With no panel attached this is how the interface can be looked at: the
        framebuffer is sent as base64 rows ("UIROW <n> <data>") a few seconds after
        boot, and tools/decode_screen_dump.py turns a captured log into a PNG. Off by
        default: it is a diagnostic, and it slows the boot it is enabled on.

        Only the headless path keeps a framebuffer of its own to dump. The panel board
        serves the frame the RGB peripheral is scanning instead
        (CONFIG_APP_UI_SCREEN_HTTP): those buffers are LVGL's own draw targets in direct
        mode, so they are readable.

        See docs/research/radio-player-memory-and-lvgl.md.

config APP_UI_DUMP_STRIDE
    int "Sample every Nth pixel when dumping the screen"
    depends on APP_UI_SERIAL_DUMP
    default 2
    range 1 8
    help
        The console runs at 115200 baud, so a full 800x480 dump takes minutes. Every
        second pixel in both directions makes it 400x240 and about twenty seconds,
        which is enough to check a layout and quick enough to iterate on.

config APP_UI_SCREEN_HTTP
    bool "Serve the rendered screen as /api/screen.bmp, and re-aim the scene over HTTP"
    default n
    help
        A way to look at the screen from a shell, on either board. On the panel board the
        frame is LVGL's own direct-mode buffer in PSRAM; on the headless one it is the
        full-frame buffer the console dump already needs, kept for the life of the process
        while this is on. GET /api/screen.bmp is a 24-bit BMP that opens in any viewer, and
        POST /api/scene?n=0..8 re-aims the scene driver while the device runs, so one
        build photographs every scene.

        Off by default: it is a diagnostic for capture runs, it adds two routes, and a
        request copies 768 KB into PSRAM before it streams.

config APP_UI_DUMP_SCENE
    int "Scene the dump is taken in (0 = entry, 1 = Art/Empty, 2 = Art/EQ, 3 = Art/RGB, 4 = Art/Menu, 5 = Real/EQ, 6 = Art/EQ with the 3x dial open, 7 = Art/RGB with the effect dial open, 8 = the Peek, 9 = Real/RGB, 10 = the two-finger pose)"
    depends on APP_UI_SERIAL_DUMP || APP_UI_SCREEN_HTTP
    range 0 10
    default 0
    help
        The dump is taken at whatever the screen is showing four seconds after boot,
        which at rest is the entry view with no chrome at all. This forces the controls
        up first - and a group, or the Menu - so a captured log is a picture of the new
        chrome rather than of the cassette. 0 leaves the screen at the entry view.

        The Menu is the panel board's own module, so scene 4 only draws on that board;
        the headless build compiles its scenes 1..3, 5, 6 and 7. Scenes 6 and 7 arm a
        knob's delayed open, which is the only way to photograph the 3x dial with no
        finger.

        Combine with APP_UI_DUMP_STRIDE=1 when the ink matters and not only the layout:
        two-pixel marks alias badly at every second pixel.

config APP_UI_MARK_HOLD_MS
    int "How long the boot mark stays up before the cassette (ms)"
    default 2000
    range 0 10000
    help
        The mark is decorative and has a dwell of its own: it is painted after
        app_services_start() has finished the boot's flash work (the Snapshot and Wi-Fi's
        NVS), the backlight is lit over it, and it stays up for this long
        before the cassette replaces it. It is the one moment the boot shows something
        without also touching flash, so it is held rather than rushed.

        The dwell starts when the mark is actually lit, not when the panel is created. 0
        removes it: the cassette follows the mark immediately. It does not affect how long
        the boot takes before the panel's first clock - that is the services' time.

config APP_UI_PACK_ANNULUS
    bool "Dirty only the band a two-finger fill moves, not the pack's whole box (experimental)"
    depends on APP_BOARD_SUNTON_8048S050C
    default n
    help
        The annulus invalidation from docs/research/cassette-render-cost.md: at the two-finger
        pose the pack is one filled body with one edge, so a fill change only dirties the band
        between the old and new edge. It makes the fill frame about 4x cheaper (369 -> 87 ms)
        and the live draw 30% smaller, with the edge still moving every bar step.

        Parked, not shipping: a rewind showed a rectangular seam and a tab on the pack in a
        photograph, while captures of the same build through a Track change were clean. Until
        that is reproduced and understood, the shipping path is the full-box invalidation.

config APP_UI_RENDER_BENCH
    bool "Measure the cost of drawing each cassette area (panel board)"
    depends on APP_BOARD_SUNTON_8048S050C
    default n
    help
        A diagnostic, not a feature. A few seconds after the screen is built
        (BENCH_START_MS, 40 s in the source) the view is frozen on the cassette, and
        one area at a time is dirtied - a hub's spokes, a pack's rings, a strand, the
        label, the Card and its mask, the window, the whole tape body, the whole panel -
        plus the two real animation steps (a hub tick and a tape-fill tick)
        and the frame the two-finger pose costs. Each is timed from LVGL's own render and
        flush events, split into the draw and the panel wait, and printed as one `bench:`
        line. The default entry screen runs first, then the two-finger pose.

        It stops the station updates and, if the performance monitor is built, pauses it,
        so a sample's frame is the frame the bench asked for. At the end the view is live
        again. Leave it off: it prints about sixty lines and spends most of a minute at the
        two-finger pose's mask draw.

        The numbers are only comparable on the same build, the same panel and the same
        content (the label's texts, the fills the tape held when it froze).

config APP_UI_RENDER_BENCH_LIVE
    bool "Measure the live animation frames instead of the per-area sweep"
    depends on APP_UI_RENDER_BENCH
    default n
    help
        The sweep prices one area per frame. This prices the frames the screen really
        draws: it enters the two-finger pose, lets the animation run for 60 s and labels
        every rendered frame with what it carried - a hub tick, a tape-fill change, an
        ink change, a label change, or a combination. One `bench: live` line per
        combination gives its frame count, mean draw, total draw and share of the
        window, plus the window's frame count and mean cycle.

        Use it to decide whether changing an animation's cadence pays: the sweep says
        what one fill costs, this says how often it is paid and against what else.

# The RGB panel has no reset line on this board, so what happens between power-on and
# its first clock is a hardware behaviour worth a knob.
menu "Panel"
    depends on APP_BOARD_SUNTON_8048S050C

config APP_UI_PANEL_SETTLE_MS
    int "Wait for the panel's supply before the RGB peripheral starts (ms)"
    default 250
    range 0 2000
    help
        The panel has no reset line: the RGB panel driver sends it no commands at all
        (esp_lcd_panel_reset() and esp_lcd_panel_init() are no-ops for the RGB
        peripheral), and the board profile wires no display-enable pin either. Its own
        power-on reset is the only one it gets, so a signal that arrives while it is
        still starting up can leave it in a state that reads as a shifted or wrapped
        picture until the next power cycle.

        This waits, with the backlight already held off, before the peripheral is
        created - so before the first signal reaches the panel. The cost is exactly this
        much boot latency, paid before the boot mark appears; 0 disables it.

        Since the first clock is now deferred until after app_services_start(), this wait
        is no longer what keeps the first clock away from a panel that is still starting;
        it stays because it also keeps the GPIO routing and the first data lines off the
        panel until its supply has settled. It costs one delay, and the panel has no reset
        to recover with.

        Tune it against a COLD start - pull power, let the bulk capacitors drain, boot -
        and not against a warm reboot, where the rail never left and the panel never
        reset. That cuts both ways and is easy to lose hours to: a flash or a reset drops
        the SoC's reset pin and nothing else, so a shifted picture *outlives* the reboot
        that was meant to clear it, and a build judged right after `idf.py flash` is being
        judged on the previous power cycle. Change the value, then pull power, several
        times, and only then believe the result. If a cold start still lands displaced with a large value here, the supply
        is not the cause; the panel is locking onto a frame the peripheral started
        mid-scan, and the lever is the driver's own restart, not a delay.

endmenu

# The backlight is the panel's pin and the idle ladder is measured on the touch
# clock, so the whole group is a panel-board property. One dependency here, not one
# per symbol below.
menu "Backlight"
    depends on APP_BOARD_SUNTON_8048S050C

config APP_UI_BACKLIGHT_AWAKE_PCT
    int "Backlight brightness while awake (%)"
    default 100
    range 1 100
    help
        The boot level and the level a touch restores. The maximum by default.

config APP_UI_BACKLIGHT_PWM_HZ
    int "Backlight PWM frequency (Hz)"
    default 400
    range 100 50000
    help
        The frequency on GPIO 2. 400 Hz with 8-bit resolution is what the
        board's reference firmware (xtouch-pro / esp32_smartdisplay) uses.
        Higher frequencies made this panel cut out part-way down the range.

config APP_UI_BACKLIGHT_DIM1_S
    int "First dim delay (s)"
    default 120
    range 5 36000
    help
        After this long with no touch the backlight fades to
        APP_UI_BACKLIGHT_DIM1_PCT. Default two minutes. The timer follows
        LVGL's own inactivity clock, so it counts from any press, not from a
        separate poll.

config APP_UI_BACKLIGHT_DIM1_PCT
    int "First dim brightness (%)"
    default 60
    range 0 100

config APP_UI_BACKLIGHT_DIM2_S
    int "Second dim delay (s)"
    default 300
    range 5 36000
    help
        Idle time for the second step, measured from the same last touch as the
        first. Default five minutes.

config APP_UI_BACKLIGHT_DIM2_PCT
    int "Second dim brightness (%)"
    default 30
    range 0 100

config APP_UI_BACKLIGHT_DIM3_S
    int "Third dim delay (s)"
    default 600
    range 5 36000
    help
        Idle time for the last step. Default ten minutes, with the third level
        at 0%: the backlight is off, and the next touch fades it back to
        APP_UI_BACKLIGHT_AWAKE_PCT.

config APP_UI_BACKLIGHT_DIM3_PCT
    int "Third dim brightness (%)"
    default 0
    range 0 100

config APP_UI_BACKLIGHT_DIM_FADE_MS
    int "Backlight dim fade time (ms)"
    default 2500
    range 0 10000
    help
        How long the fade down to a dimmer level takes. Long enough that the
        step is visible rather than a cut; 0 switches instantly.

config APP_UI_BACKLIGHT_WAKE_FADE_MS
    int "Backlight wake fade time (ms)"
    default 300
    range 0 5000
    help
        How long the fade back to the awake level takes. Shorter than the dim:
        a touch should feel like it brought the screen back, not like it is
        still waking up.

config APP_UI_BACKLIGHT_TEST
    bool "Visual backlight test screen"
    default n
    help
        Replaces the cassette with a white test screen and steps the backlight
        through 100, 80, 60, 40, 20 and 0 percent, five seconds at each level.
        The current level is printed in large type, so the PWM range can be
        checked on the panel without waiting for the sleep timer. It is a
        diagnostic build: leave it off for the normal interface.

endmenu

endmenu
```

## components/app/strip/Kconfig
```kconfig
menu "Strip"

config APP_STRIP_MAX_PCT
    int "The strip's power ceiling, as a percent of full"
    range 0 100
    default 25
    help
        Eight WS2812B pixels at full white draw about 480 mA - 60 mA each, 20 mA a
        channel. On this board that was enough to brown it out: the strip lit at full
        white and the device rebooted under the audio load.

        The ceiling is the last stage of the frame, after the effect and the brightness,
        so no effect and no knob position can ask for more than this share of full
        power. It caps the current rather than the display: 25% is about 120 mA for
        eight pixels at white, and a single colour at the same 25% is a third of that.

        Raise it if the strip has its own supply with headroom; drop it if the board
        still resets. The measured figure is in docs/specs/led-strip.md, "Power".
endmenu
```
