## components/app/screen_display/Kconfig
```kconfig
menu "Screen display"

config APP_UI_SERIAL_DUMP
    bool "Dump the rendered screen over the serial console once at startup"
    depends on !APP_BOARD_SUNTON_8048S050C
    default n
    help
        With no panel attached this is how the interface can be looked at: the
        framebuffer is sent as base64 rows ("UIROW <n> <data>") a few seconds after
        boot, and tools/decode_screen_dump.py turns a captured log into a PNG. Off by
        default: it is a diagnostic, and it slows the boot it is enabled on.

        Only the headless path keeps a framebuffer of its own to dump. The panel board
        serves the frame the RGB peripheral is scanning instead
        (CONFIG_APP_UI_SCREEN_HTTP): those buffers are LVGL's own draw targets in direct
        mode, so they are readable.

        See docs/research/radio-player-memory-and-lvgl.md.

config APP_UI_DUMP_STRIDE
    int "Sample every Nth pixel when dumping the screen"
    depends on APP_UI_SERIAL_DUMP
    default 2
    range 1 8
    help
        The console runs at 115200 baud, so a full 800x480 dump takes minutes. Every
        second pixel in both directions makes it 400x240 and about twenty seconds,
        which is enough to check a layout and quick enough to iterate on.

config APP_UI_SCREEN_HTTP
    bool "Serve the rendered screen as /api/screen.bmp, and re-aim the scene over HTTP"
    default n
    help
        A way to look at the screen from a shell, on either board. On the panel board the
        frame is LVGL's own direct-mode buffer in PSRAM; on the headless one it is the
        full-frame buffer the console dump already needs, kept for the life of the process
        while this is on. GET /api/screen.bmp is a 24-bit BMP that opens in any viewer, and
        POST /api/scene?n=0..8 re-aims the scene driver while the device runs, so one
        build photographs every scene.

        Off by default: it is a diagnostic for capture runs, it adds two routes, and a
        request copies 768 KB into PSRAM before it streams.

config APP_UI_DUMP_SCENE
    int "Scene the dump is taken in (0 = entry, 1 = Art/Empty, 2 = Art/EQ, 3 = Art/RGB, 4 = Art/Menu, 5 = Real/EQ, 6 = Art/EQ with the 3x dial open, 7 = Art/RGB with the effect dial open, 8 = the Peek, 9 = Real/RGB)"
    depends on APP_UI_SERIAL_DUMP || APP_UI_SCREEN_HTTP
    range 0 9
    default 0
    help
        The dump is taken at whatever the screen is showing four seconds after boot,
        which at rest is the entry view with no chrome at all. This forces the controls
        up first - and a group, or the Menu - so a captured log is a picture of the new
        chrome rather than of the cassette. 0 leaves the screen at the entry view.

        The Menu is the panel board's own module, so scene 4 only draws on that board;
        the headless build compiles its scenes 1..3, 5, 6 and 7. Scenes 6 and 7 arm a
        knob's delayed open, which is the only way to photograph the 3x dial with no
        finger.

        Combine with APP_UI_DUMP_STRIDE=1 when the ink matters and not only the layout:
        two-pixel marks alias badly at every second pixel.

# The RGB panel has no reset line on this board, so what happens between power-on and
# its first clock is a hardware behaviour worth a knob.
menu "Panel"
    depends on APP_BOARD_SUNTON_8048S050C

config APP_UI_PANEL_SETTLE_MS
    int "Wait for the panel's supply before the RGB peripheral starts (ms)"
    default 250
    range 0 2000
    help
        The panel has no reset line: the RGB panel driver sends it no commands at all
        (esp_lcd_panel_reset() and esp_lcd_panel_init() are no-ops for the RGB
        peripheral), and the board profile wires no display-enable pin either. Its own
        power-on reset is the only one it gets, so a signal that arrives while it is
        still starting up can leave it in a state that reads as a shifted or wrapped
        picture until the next power cycle.

        This waits, with the backlight already held off, before the peripheral is
        created - so before the first clock, the first data line and the first frame
        reach the panel. The cost is exactly this much boot latency, paid before the
        boot mark appears; 0 disables it.

        Tune it against a COLD start - pull power, let the bulk capacitors drain, boot -
        and not against a warm reboot, where the rail never left and the panel never
        reset. That cuts both ways and is easy to lose hours to: a flash or a reset drops
        the SoC's reset pin and nothing else, so a shifted picture *outlives* the reboot
        that was meant to clear it, and a build judged right after `idf.py flash` is being
        judged on the previous power cycle. Change the value, then pull power, several
        times, and only then believe the result. If a cold start still lands displaced with a large value here, the supply
        is not the cause; the panel is locking onto a frame the peripheral started
        mid-scan, and the lever is the driver's own restart, not a delay.

endmenu

# The backlight is the panel's pin and the idle ladder is measured on the touch
# clock, so the whole group is a panel-board property. One dependency here, not one
# per symbol below.
menu "Backlight"
    depends on APP_BOARD_SUNTON_8048S050C

config APP_UI_BACKLIGHT_AWAKE_PCT
    int "Backlight brightness while awake (%)"
    default 100
    range 1 100
    help
        The boot level and the level a touch restores. The maximum by default.

config APP_UI_BACKLIGHT_PWM_HZ
    int "Backlight PWM frequency (Hz)"
    default 400
    range 100 50000
    help
        The frequency on GPIO 2. 400 Hz with 8-bit resolution is what the
        board's reference firmware (xtouch-pro / esp32_smartdisplay) uses.
        Higher frequencies made this panel cut out part-way down the range.

config APP_UI_BACKLIGHT_DIM1_S
    int "First dim delay (s)"
    default 120
    range 5 36000
    help
        After this long with no touch the backlight fades to
        APP_UI_BACKLIGHT_DIM1_PCT. Default two minutes. The timer follows
        LVGL's own inactivity clock, so it counts from any press, not from a
        separate poll.

config APP_UI_BACKLIGHT_DIM1_PCT
    int "First dim brightness (%)"
    default 60
    range 0 100

config APP_UI_BACKLIGHT_DIM2_S
    int "Second dim delay (s)"
    default 300
    range 5 36000
    help
        Idle time for the second step, measured from the same last touch as the
        first. Default five minutes.

config APP_UI_BACKLIGHT_DIM2_PCT
    int "Second dim brightness (%)"
    default 30
    range 0 100

config APP_UI_BACKLIGHT_DIM3_S
    int "Third dim delay (s)"
    default 600
    range 5 36000
    help
        Idle time for the last step. Default ten minutes, with the third level
        at 0%: the backlight is off, and the next touch fades it back to
        APP_UI_BACKLIGHT_AWAKE_PCT.

config APP_UI_BACKLIGHT_DIM3_PCT
    int "Third dim brightness (%)"
    default 0
    range 0 100

config APP_UI_BACKLIGHT_DIM_FADE_MS
    int "Backlight dim fade time (ms)"
    default 2500
    range 0 10000
    help
        How long the fade down to a dimmer level takes. Long enough that the
        step is visible rather than a cut; 0 switches instantly.

config APP_UI_BACKLIGHT_WAKE_FADE_MS
    int "Backlight wake fade time (ms)"
    default 300
    range 0 5000
    help
        How long the fade back to the awake level takes. Shorter than the dim:
        a touch should feel like it brought the screen back, not like it is
        still waking up.

config APP_UI_BACKLIGHT_TEST
    bool "Visual backlight test screen"
    default n
    help
        Replaces the cassette with a white test screen and steps the backlight
        through 100, 80, 60, 40, 20 and 0 percent, five seconds at each level.
        The current level is printed in large type, so the PWM range can be
        checked on the panel without waiting for the sleep timer. It is a
        diagnostic build: leave it off for the normal interface.

endmenu

endmenu
```

## components/portable/front_door/Kconfig
```kconfig
menu "Front door"

config FRONT_DOOR_LAUNCH_URL
    string "Where the device's address sends a browser"
    default "https://k7.xperiments.dev/#/player"
    help
        The device serves no page of its own (ADR 0067), so its address is a doorbell:
        GET / answers 302 to this URL. A development build points it at the development
        origin, for example https://k7-dev.xperiments.dev:8000/#/player.

endmenu
```

## main/Kconfig.projbuild
```kconfig
menu "SD stream server"

choice APP_BOARD
    prompt "Which board is this firmware for"
    default APP_BOARD_DEVKIT
    help
        The board decides the display. The development board has none, so the interface
        is rendered into a framebuffer this firmware owns (and can be dumped over the
        console to look at). The Sunton 8048S050C has an 800x480 RGB panel whose two
        framebuffers live in PSRAM and are scanned out by the RGB peripheral.

        Per-board settings that are not a Kconfig choice - PSRAM and flash speed above
        all - live in a separate defaults file: see sdkconfig.defaults.sunton and the
        README's board section.

config APP_BOARD_DEVKIT
    bool "ESP32-S3 development board (no panel)"

config APP_BOARD_SUNTON_8048S050C
    bool "Sunton 8048S050C (800x480 RGB panel, GT911 touch)"

endchoice

endmenu
```
